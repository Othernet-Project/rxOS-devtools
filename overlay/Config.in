## overlay/Config.in
```kconfig
config RXOS_OVERLAY_NAME
	string "Overlay name"
	help
	  Name of the overlay that will be used in the
	  output file. The overlay file name will be 
	  overlay-<name>-<version>.sqfs. 
	  
	  DO NOT INCLUDE SPACES OR DASHES IN THE NAME.


config RXOS_OVERLAY_VERSION
	string "Overlay version"
	help
	  Version of the overlay that will be used in the
	  output file. The overlay file name will be 
	  overlay-<name>-<version>.sqfs. If the version
	  is left blank, current date will be used instead.

	  DO NOT INCLUDE SPACES OR DASHES IN THE VERSION.
```

## overlay/configs/overlay_defconfig
```kconfig
BR2_arm=y
BR2_cortex_a7=y
BR2_ARM_FPU_NEON_VFPV4=y
BR2_KERNEL_HEADERS_VERSION=y
BR2_DEFAULT_KERNEL_VERSION="4.1.21"
BR2_PACKAGE_HOST_LINUX_HEADERS_CUSTOM_4_1=y
BR2_TOOLCHAIN_BUILDROOT_GLIBC=y
BR2_GLIBC_VERSION_2_22=y
BR2_TOOLCHAIN_BUILDROOT_CXX=y
BR2_INIT_NONE=y
BR2_ROOTFS_DEVICE_CREATION_STATIC=y
BR2_ROOTFS_DEVICE_TABLE=""
BR2_ROOTFS_STATIC_DEVICE_TABLE=""
BR2_ROOTFS_SKELETON_CUSTOM=y
BR2_ROOTFS_SKELETON_CUSTOM_PATH="$(BR2_EXTERNAL)/skeleton"
BR2_ROOTFS_POST_IMAGE_SCRIPT="$(BR2_EXTERNAL)/scripts/dedupe.sh"
# BR2_PACKAGE_BUSYBOX is not set
BR2_PACKAGE_RPI_FIRMWARE=y
# BR2_PACKAGE_RPI_FIRMWARE_INSTALL_DTB_OVERLAYS is not set
BR2_PACKAGE_LIBCURL=y
BR2_PACKAGE_CURL=y
BR2_PACKAGE_IFTOP=y
BR2_PACKAGE_NETCAT=y
BR2_PACKAGE_RSYNC=y
BR2_PACKAGE_TCPING=y
BR2_PACKAGE_SCREEN=y
BR2_PACKAGE_HTOP=y
BR2_PACKAGE_UTIL_LINUX=y
BR2_PACKAGE_UTIL_LINUX_BINARIES=y
BR2_PACKAGE_MC=y
BR2_PACKAGE_HOST_SQUASHFS=y
RXOS_OVERLAY_NAME="devtools"
```
